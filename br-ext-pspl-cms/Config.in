## br-ext-pspl-cms/Config.in
```kconfig
source "$BR2_EXTERNAL_PSPL_CMS_PATH/package/pspl-cms-init/Config.in"
source "$BR2_EXTERNAL_PSPL_CMS_PATH/package/daqhats/Config.in"
```

## br-ext-pspl-cms/package/daqhats/Config.in
```kconfig
config BR2_PACKAGE_DAQHATS
	bool "daqhats"
	depends on BR2_PACKAGE_LIBGPIOD
	depends on BR2_PACKAGE_LIBGPIOD_TOOLS
    depends on BR2_PACKAGE_GTK3
	help
	  DAQ HATs support package for Raspberry Pi.
	  https://github.com/mccdaq/daqhats
```

## buildroot-external/Config.in
```kconfig
if BR2_TARGET_CMS
source "$BR2_EXTERNAL_PSPL_CMS_PATH/package/avi-cms-fsw/Config.in"
endif

if BR2_TARGET_CPH
source "$BR2_EXTERNAL_PSPL_CMS_PATH/package/avi-cph-fsw/Config.in"
endif
```

## buildroot-external/configs/pspl_cms_pi4_defconfig
```kconfig
BR2_aarch64=y
BR2_cortex_a72=y
BR2_ARM_FPU_VFPV4=y
BR2_PER_PACKAGE_DIRECTORIES=y
BR2_TOOLCHAIN_BUILDROOT_CXX=y
BR2_SYSTEM_DHCP="eth0"
BR2_GLOBAL_PATCH_DIR="board/raspberrypi/patches"
BR2_ROOTFS_OVERLAY="$(BR2_EXTERNAL_PSPL_CMS_PATH)/board/raspberrypi/rootfs_overlay"
BR2_ROOTFS_POST_BUILD_SCRIPT="board/raspberrypi4-64/post-build.sh"
BR2_ROOTFS_POST_IMAGE_SCRIPT="$(BR2_EXTERNAL_PSPL_CMS_PATH)/board/raspberrypi/post-image.sh"
BR2_ROOTFS_DEVICE_CREATION_DYNAMIC_EUDEV=y

# == Skeleton Configuration ==
# BR2_TARGET_GENERIC_ISSUE="$(git describe --tags --dirty --always)"
BR2_TARGET_GENERIC_HOSTNAME="pspl-cms-avi-fc"
BR2_TARGET_ENABLE_ROOT_LOGIN=y

# generated with `mkpasswd -m sha512crypt`
BR2_TARGET_GENERIC_ROOT_PASSWD="$$6$$HXWGeOjuiHRUpx7g$$uX0zUMKhbJ8LrKRIYnsNQjGC32Jo0445AHOpj57Z/IcoEFR2LAUlsfqwMVjrhCswgmHVOmU8YBplVb7sAWpO.1"

# == Toolchain ==
BR2_TOOLCHAIN_EXTERNAL=y
BR2_TOOLCHAIN_EXTERNAL_ARM_AARCH64=y

# == Linux Config ==
BR2_LINUX_KERNEL=y
BR2_LINUX_KERNEL_CUSTOM_GIT=y
BR2_LINUX_KERNEL_CUSTOM_REPO_URL="https://github.com/raspberrypi/linux.git"
BR2_LINUX_KERNEL_CUSTOM_REPO_VERSION="0b540ffdabcc31e8aff2b190599dea2fcba102ac" # rpi-6.12.y
BR2_LINUX_KERNEL_DEFCONFIG="bcm2711"
BR2_LINUX_KERNEL_CONFIG_FRAGMENT_FILES="$(BR2_EXTERNAL_PSPL_CMS_PATH)/board/raspberrypi/linux.fragment"
BR2_LINUX_KERNEL_DTS_SUPPORT=y
BR2_LINUX_KERNEL_INTREE_DTS_NAME="broadcom/bcm2711-rpi-4-b"
BR2_LINUX_KERNEL_NEEDS_HOST_OPENSSL=y
BR2_PACKAGE_HOST_LINUX_HEADERS_CUSTOM_6_12=y

# == Packages ==
BR2_PACKAGE_BUSYBOX_SHOW_OTHERS=y
BR2_PACKAGE_XZ=y
BR2_PACKAGE_RPI_FIRMWARE=y
BR2_PACKAGE_RPI_FIRMWARE_VARIANT_PI4=y
BR2_PACKAGE_RPI_FIRMWARE_CONFIG_FILE="$(BR2_EXTERNAL_PSPL_CMS_PATH)/board/raspberrypi/config.txt"
BR2_PACKAGE_KMOD=y
BR2_PACKAGE_KMOD_TOOLS=y

BR2_PACKAGE_UTIL_LINUX=y
BR2_PACKAGE_UTIL_LINUX_LIBS=y
BR2_PACKAGE_UTIL_LINUX_LIBUUID=y
BR2_PACKAGE_PARTED=y
BR2_PACKAGE_E2FSPROGS=y
BR2_PACKAGE_E2FSPROGS_RESIZE2FS=y

BR2_PACKAGE_BASH=y
BR2_PACKAGE_HTOP=y
BR2_PACKAGE_PYTHON3=y
BR2_PACKAGE_OPENSSH=y
BR2_PACKAGE_LIBGPIOD=y
BR2_PACKAGE_LIBGPIOD_TOOLS=y
BR2_PACKAGE_RASPI_GPIO=y
BR2_PACKAGE_DTC=y
BR2_PACKAGE_RPI_USERLAND=y
BR2_PACKAGE_AVI_FSW=y

# == Output ==
BR2_PACKAGE_HOST_DOSFSTOOLS=y
BR2_PACKAGE_HOST_GENIMAGE=y
BR2_PACKAGE_HOST_KMOD_XZ=y
BR2_PACKAGE_HOST_MTOOLS=y

BR2_TARGET_ROOTFS_SQUASHFS=y

# == ccache ==
BR2_CCACHE=y
BR2_CCACHE_INITIAL_SETUP=""
BR2_CCACHE_USE_BASEDIR=y
```

## buildroot-external/package/avi-cms-fsw/Config.in
```kconfig
config BR2_PACKAGE_AVI_FSW
	bool "avi-fsw"
    select BR2_PACKAGE_LIBGPIOD
	help
	  CMS COTS Avionics Flight Software
	  https://github.com/Purdue-Space-Program/PSPL_CMS_AVIONICS_COTS_FSW
```

## buildroot-external/package/daqhats/Config.in
```kconfig
config BR2_PACKAGE_DAQHATS
	bool "daqhats"
    select BR2_PACKAGE_LIBGPIOD
	help
	  DAQ HATs support package for Raspberry Pi.
	  https://github.com/mccdaq/daqhats
```

## buildroot-external/package/pspl-cms-init/Config.in
```kconfig
config BR2_PACKAGE_PSP_CMS_INIT
	bool "pspl-cms-init"
	depends on !BR2_INIT_BUSYBOX && !BR2_INIT_SYSTEMD && !BR2_INIT_SYSV && !BR2_INIT_NONE
	help
	  PSP CMS custom init system
```
